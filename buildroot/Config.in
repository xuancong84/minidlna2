## buildroot/microdlna/Config.in
```kconfig
config BR2_PACKAGE_MICRODLNA
	bool "microdlna"
	depends on BR2_USE_WCHAR # flac
	depends on BR2_USE_MMU # fork
	depends on BR2_TOOLCHAIN_HAS_THREADS
	depends on BR2_PACKAGE_FFMPEG_ARCH_SUPPORTS
	select BR2_PACKAGE_FFMPEG
	select BR2_PACKAGE_FLAC
	select BR2_PACKAGE_LIBVORBIS # selects libogg
	select BR2_PACKAGE_LIBOGG
	select BR2_PACKAGE_LIBID3TAG # selects zlib
	select BR2_PACKAGE_LIBEXIF
	select BR2_PACKAGE_JPEG
	select BR2_PACKAGE_SQLITE
	select BR2_PACKAGE_ICU
	select BR2_PACKAGE_ZLIB
	help
	  microDLNA is a DLNA/UPnP-AV media server for giant media
	  folders, derived from MiniDLNA (aka ReadyMedia).

	  https://github.com/xuancong84/minidlna2

comment "microdlna needs a toolchain w/ threads, wchar"
	depends on BR2_USE_MMU
	depends on BR2_PACKAGE_FFMPEG_ARCH_SUPPORTS
	depends on !BR2_TOOLCHAIN_HAS_THREADS || !BR2_USE_WCHAR
```
